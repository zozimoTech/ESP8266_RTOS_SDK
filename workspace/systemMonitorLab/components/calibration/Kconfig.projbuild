## workspace/systemMonitorLab/components/calibration/Kconfig.projbuild
```kconfig
menu "Calibration Parameters"

config APP_CALIBRATION_PRESSURE_OFFSET
    string "Pressure offset"
    default "0.0"
    help
        Offset de calibracion de presion para la funcion lineal.
        Puede utilizar valores decimales.

config APP_CALIBRATION_PRESSURE_SLOPE
    string "Pressure slope"
    default "1.0"
    help
        Pendiente de calibracion de presion para la funcion lineal.
        Puede utilizar valores decimales.

config APP_CALIBRATION_TEMPERATURE_OFFSET
    string "Temperature offset"
    default "0.0"
    help
        Offset de calibracion de temperatura para la funcion lineal.
        Puede utilizar valores decimales.

config APP_CALIBRATION_TEMPERATURE_SLOPE
    string "Temperature slope"
    default "1.0"
    help
        Pendiente de calibracion de temperatura para la funcion lineal.
        Puede utilizar valores decimales.

config APP_CALIBRATION_HUMIDITY_OFFSET
    string "Humidity offset"
    default "0.0"
    help
        Offset de calibracion de humedad para la funcion lineal.
        Puede utilizar valores decimales.

config APP_CALIBRATION_HUMIDITY_SLOPE
    string "Humidity slope"
    default "1.0"
    help
        Pendiente de calibracion de humedad para la funcion lineal.
        Puede utilizar valores decimales.

endmenu
```

## workspace/systemMonitorLab/main/Kconfig.projbuild
```kconfig
menu "System Monitor Configuration"
config APP_NUMBER_OF_NODE
    int "Node number"
    range 0 255
    default 0
    help
        Numero de nodo del dispositivo. Este valor se usara para identificar el nodo en el servidor WebSocket.
config APP_WIFI_SSID
    string "WiFi SSID"
    default "mi_wifi"
    help
        Nombre de la red Wi-Fi a la que se conectara el dispositivo.

config APP_WIFI_PASSWORD
    string "WiFi password"
    default "mi_password"
    help
        Contrasena de la red Wi-Fi. Dejela vacia para una red abierta.

# Opciones propias de los LED de estado de la aplicación.
config APP_STATUS_LED_ENABLE
    bool "Enable status LEDs"
    default y

if APP_STATUS_LED_ENABLE

# GPIO conectado al canal rojo del LED dual.
config APP_LED_RED_GPIO
    int "Red LED GPIO"
    range 0 16
    default 12

# GPIO conectado al canal verde del LED dual.
config APP_LED_GREEN_GPIO
    int "Green LED GPIO"
    range 0 16
    default 13

# Duty del canal verde usado junto con rojo para producir naranja.
config APP_LED_ORANGE_GREEN_DUTY
    int "Green PWM duty for orange (percent)"
    range 0 100
    default 40

endif

choice APP_SERVER_IP_MODE
    prompt "IP Version"
    help
    El cliente WebSocket puede usar IPv4 o IPv6.

config APP_SERVER_IPV4
    bool "IPV4"

config APP_SERVER_IPV6
   bool "IPV6"

endchoice

config APP_SERVER_IPV4_ADDR
    string "IPV4 Address"
    default "192.168.0.165"
    depends on APP_SERVER_IPV4
    help
         Direccion IPv4 del servidor WebSocket.

config APP_SERVER_IPV6_ADDR
    string "IPV6 Address"
    default "FE80::30AD:E57B:C212:68AD"
    depends on APP_SERVER_IPV6
    help
         Direccion IPv6 del servidor WebSocket.

config APP_SERVER_PORT
    int "Port"
    range 0 65535
    default 3333
    help
        Puerto remoto del servidor WebSocket.

config APP_SAMPLE_RATE_SENSORS
    int "Sample Rate"
    range 1 43200
    default 10
    help
        Tasa de muestreo de los sensores en segundos. El valor de sampling debe ser menor al tiempo de transmision de los datos al servidor WebSocket.
config APP_TRANSMISSION_RATE
    int "Transmission Rate"
    range 1 86400
    default 60
    help
        Tasa de transmision de los datos al servidor WebSocket en segundos. El valor de transmision debe ser mayor al tiempo de muestreo de los sensores.
endmenu
```
